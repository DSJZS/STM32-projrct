/***************************************************************************************
  * 本菜单为时钟菜单的二级子菜单，用于显示世界主要城市的世界(由于屏幕大小原因，只显示了4个城市的)
  ***************************************************************************************
  */

#include "ClockMenu_Time.h"
#include "stm32f10x.h"                  // Device header
#include "OLED.h"
#include "Menu.h"

#include "Key.h"
#include "MyRTC.h"
#include "Timer.h"

#include "MSG.h"

/*图像数据*********************/

/*	世界时间菜单图标	——	地球的某一部分	*/
const uint8_t ClockMenu_Time_Icon[] = {
	0x00,0x00,0x00,0x00,0x00,0x00,0x00,0x00,0x80,0x40,0x20,0x10,0x10,0x08,0x08,0x1C,
	0x24,0x24,0x42,0x82,0x82,0x81,0x81,0x81,0x81,0x81,0x81,0x82,0x42,0x42,0x44,0x44,
	0x44,0x48,0x48,0x50,0x90,0x20,0x40,0x80,0x00,0x00,0x00,0x00,0x00,0x00,0x00,0x00,
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	0x20,0x10,0x10,0x08,0x08,0x04,0x02,0x01,0x00,0x00,0x00,0x00,0x00,0x00,0x00,0x00,
};

/*********************图像数据*/





/*全局变量*********************/

/*	世界时间菜单结构体	*/
Menu ClockMenu_Time;	

/*	世界时间菜单名字	*/
const char* ClockMenu_Time_Name = "世界时间";

/*********************全局变量*/





/*功能函数*********************/

/**
  * 函    数：世界时钟菜单循环
  * 参    数：无
  * 返 回 值：无
  * 说    明：用于每隔一段时间读取新的时间数据并且显示
  *           应该每隔少于或者等于一秒的时间执行一次
  */
static void ClockMenu_Time_Loop(void)
{
	OLED_Clear();	//	清屏
	
	MyRTC_ReadTime();	//	读取新的时间数据
	
	/*显示地点*/
	OLED_ShowChinese( 0, 0,"北京");
	OLED_ShowChinese( 0,16,"东京");
//	OLED_ShowChinese( 0, 0,"旧金山");
	OLED_ShowChinese( 0,32,"纽约");
	OLED_ShowChinese( 0,48,"伦敦");
//	OLED_ShowChinese( 0, 0,"巴黎");
//	OLED_ShowChinese( 0, 0,"安卡拉");
//	OLED_ShowChinese( 0, 0,"莫斯科");
	/*显示地点*/
	
	/*显示当地时间*/
	OLED_Printf( 64,  0, OLED_8X16, "%2d:%2d:%2d", (MyRTC_Time[3]+8)%24, MyRTC_Time[4], MyRTC_Time[5]);
	OLED_Printf( 64, 16, OLED_8X16, "%2d:%2d:%2d", (MyRTC_Time[3]+9)%24, MyRTC_Time[4], MyRTC_Time[5]);
//	OLED_Printf( 64,  0, OLED_8X16, "%2d:%2d:%2d", (MyRTC_Time[3]-8+24)%24, MyRTC_Time[4], MyRTC_Time[5]);
	OLED_Printf( 64, 32, OLED_8X16, "%2d:%2d:%2d", (MyRTC_Time[3]-5+24)%24, MyRTC_Time[4], MyRTC_Time[5]);
	OLED_Printf( 64, 48, OLED_8X16, "%2d:%2d:%2d", (MyRTC_Time[3]+0)%24, MyRTC_Time[4], MyRTC_Time[5]);
//	OLED_Printf( 64,  0, OLED_8X16, "%2d:%2d:%2d", (MyRTC_Time[3]+1)%24, MyRTC_Time[4], MyRTC_Time[5]);
//	OLED_Printf( 64,  0, OLED_8X16, "%2d:%2d:%2d", (MyRTC_Time[3]+2)%24, MyRTC_Time[4], MyRTC_Time[5]);
//	OLED_Printf( 64,  0, OLED_8X16, "%2d:%2d:%2d", (MyRTC_Time[3]+3)%24, MyRTC_Time[4], MyRTC_Time[5]);
	/*显示当地时间*/
	
	OLED_Update();	//	刷新
}

/**
  * 函    数：世界时间菜单的功能函数
  * 参    数：无
  * 参    数：无
  * 返 回 值：无
  * 说    明：用于世界时间菜单的功能函数
  */
static void ClockMenu_Time_Funsion(void)
{
	MSG msg;	//	消息结构体
	
	//	将ClockMenu_Time_Loop函数添加到定时器定时列表，配置为每1s到时一次
	Timer_AddFunction( ClockMenu_Time_Loop, 1000);
	
	//	初始化ClockMenu_Time_Loop函数的当前定时值，使其开始定时后立刻到时
	Timer_SetCount(ClockMenu_Time_Loop,1000);	
	
	Timer_Start(ClockMenu_Time_Loop);	//	开始为世界时钟菜单循环函数定时
	
	while(1)
	{
		if(MSG_GetMessage(&msg))	//	获取消息
		{
			if(msg.message == CM_KEYUP && msg.param == VK_KEY2 )	//	处理按键2松开
			{
				//	将ClockMenu_Time_Loop函数从定时器定时列表删除
				Timer_DeleteFunction(ClockMenu_Time_Loop);	
				return;
			}
			else
			{
				MSG_DefaultProc(&msg);	//	消息默认处理
			}
		}
	}
}

/**
  * 函    数：初始化世界时间菜单
  * 参    数：无
  * 参    数：无
  * 返 回 值：无
  * 说    明：仅配置了世界时间菜单的功能函数、图标和名字，同级前后关系和父子菜单关系由外部决定
  */
void ClockMenu_Time_Init(void)
{
	/*初始化世界时间菜单*/
	Menu_Init(&ClockMenu_Time);
	ClockMenu_Time.Funsion = ClockMenu_Time_Funsion;
	ClockMenu_Time.Icon = ClockMenu_Time_Icon;
	ClockMenu_Time.Name = ClockMenu_Time_Name;
	/*初始化世界时间菜单*/
	
	MyRTC_Init();	//	初始化MyRTC模块
	Key_Init();		//	初始化Key模块
}

/*********************功能函数*/
